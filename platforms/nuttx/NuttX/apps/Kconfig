## src/modules/pregme_att_control/Kconfig
```kconfig
menuconfig MODULES_PREGME_ATT_CONTROL
	bool "pregme_att_control"
	default n
	---help---
		Enable the custom multicopter attitude/direct actuator control module.

menuconfig USER_PREGME_ATT_CONTROL
	bool "pregme_att_control running as userspace module"
	default n
	depends on BOARD_PROTECTED && MODULES_PREGME_ATT_CONTROL
	---help---
		Run pregme_att_control in userspace memory on protected builds.
```

## src/modules/pregme_att_control_v1/Kconfig
```kconfig
menuconfig MODULES_PREGME_ATT_CONTROL_V1
	bool "pregme_att_control_v1"
	default n
	---help---
		Enable the custom multicopter attitude/direct actuator control module.

menuconfig USER_PREGME_ATT_CONTROL_V1
	bool "pregme_att_control_v1 running as userspace module"
	default n
	depends on BOARD_PROTECTED && MODULES_PREGME_ATT_CONTROL_V1
	---help---
		Run pregme_att_control_v1 in userspace memory on protected builds.
```

## src/modules/pregme_pos_control/Kconfig
```kconfig
menuconfig MODULES_PREGME_POS_CONTROL
	bool "pregme_pos_control"
	default n
	---help---
		Enable support for pregme_pos_control

menuconfig USER_PREGME_POS_CONTROL
	bool "pregme_pos_control running as userspace module"
	default n
	depends on BOARD_PROTECTED && MODULES_PREGME_POS_CONTROL
	---help---
		Put pregme_pos_control in userspace memory
```

## src/modules/pregme_pos_control_v1/Kconfig
```kconfig
menuconfig MODULES_PREGME_POS_CONTROL_V1
	bool "pregme_pos_control_v1"
	default n
	---help---
		Enable the custom multicopter position control module.

menuconfig USER_PREGME_POS_CONTROL_V1
	bool "pregme_pos_control_v1 running as userspace module"
	default n
	depends on BOARD_PROTECTED && MODULES_PREGME_POS_CONTROL_V1
	---help---
		Run pregme_pos_control_v1 in userspace memory on protected builds.
```
